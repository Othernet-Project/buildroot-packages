## dir2fat32/Config.in
```kconfig
config BR2_PACKAGE_DIR2FAT32
	bool "dir2fat32"
	select BR2_PACKAGE_UTIL_LINUX
	select BR2_PACKAGE_DOSFSTOOLS
	select BR2_PACKAGE_MTOOLS
	help
	  Create a FAT32 disk image from the contents of a directory, without 
	  mounting or root privileges, completely automatically.

	  https://github.com/Othernet-Project/dir2fat32
```

## dir2fat32/Config.in.host
```kconfig
config BR2_PACKAGE_HOST_DIR2FAT32
	bool "host dir2fat32"
	select BR2_PACKAGE_HOST_UTIL_LINUX
	select BR2_PACKAGE_HOST_DOSFSTOOLS
	select BR2_PACKAGE_HOST_MTOOLS
	help
	  Create a FAT32 disk image from the contents of a directory, without 
	  mounting or root privileges, completely automatically.

	  https://github.com/Othernet-Project/dir2fat32
```

## firmware-brcmfmac43430-sdio/Config.in
```kconfig
config BR2_PACKAGE_FIRMWARE_BRCMFMAC43430_SDIO
	bool "firmware-brcmfmac43430-sdio"
	help
	  Binary firmware file for BCM4343x Full-MAC wireless adapter.

	  https://github.com/RPi-Distro/firmware-nonfree/
```

## firmware-mt7601u-usb/Config.in
```kconfig
config BR2_PACKAGE_FIRMWARE_MT7601U
	bool "firmware-mt7601u-usb"
	help
	  Binary firmware file for Mediatek MT7601U wireless chip.

	  http://www.mediatek.com/en/downloads1/downloads/mt7601u-usb/
```

## incron/Config.in
```kconfig
menuconfig BR2_PACKAGE_INCRON
	bool "inotify cron daemon - cron for inotify events"
	help
	  incron - inotify cron watches for filesystem events and runs processes


if BR2_PACKAGE_INCRON

config BR2_INCRON_CONFDIR
    string "incron config dir"
    default "/etc/incron.d"
    help
      Absolute path to a directory to be watched for watch config. DO NOT CHANGE, stuff will break.

endif
```

## libsdrutil/Config.in
```kconfig
config BR2_PACKAGE_LIBSDRUTIL
	bool "libsdrutil"
	select BR2_PACKAGE_LIBRTLSDR
	help
	  Utility library for use with USB SDRs.
```

## monitoring/Config.in
```kconfig
menuconfig BR2_PACKAGE_MONITORING
	bool "monitoring"
	depends on BR2_PACKAGE_PYTHON
	select BR2_PACKAGE_PYTHON_BITARRAY
	help
	  Client-side script for sending Othernet signal monitoring data to a
	  central server.
	  
	  https://github.com/Othernet-Project/monitoring


if BR2_PACKAGE_MONITORING

config BR2_MONITORING_PERSISTDIR
	string "Data directory"
	default "/mnt/persist"
	help
	  Path where monitoring should store its state.

endif # BR2_PACKAGE_MONITORING
```

## mt7601apsta/Config.in
```kconfig
config BR2_PACKAGE_MT7601APSTA
	bool "mt7601apsta"
	depends on BR2_LINUX_KERNEL
	help
	  Linux kernel module for the mt7601 non-kernel AP+STA module

	  https://github.com/Othernet-Project/mt7601u
```

## mtd-mlc/Config.in
```kconfig
config BR2_PACKAGE_MTD_MLC
	bool "mtd, jffs2 and ubi/ubifs tools"
	help
	  Build mtd, jffs2 and ubi/ubifs tools

	  http://www.linux-mtd.infradead.org/

if BR2_PACKAGE_MTD_MLC
comment "MTD tools selection"

config BR2_PACKAGE_MTD_MLC_DOCFDISK
	bool "docfdisk"

config BR2_PACKAGE_MTD_MLC_DOC_LOADBIOS
	bool "doc_loadbios"

config BR2_PACKAGE_MTD_MLC_FLASHCP
	bool "flashcp"
	default y

config BR2_PACKAGE_MTD_MLC_FLASH_ERASE
	bool "flash_erase"
	default y

config BR2_PACKAGE_MTD_MLC_FLASH_LOCK
	bool "flash_lock"
	default y

config BR2_PACKAGE_MTD_MLC_FLASH_OTP_DUMP
	bool "flash_otp_dump"

config BR2_PACKAGE_MTD_MLC_FLASH_OTP_INFO
	bool "flash_otp_info"

config BR2_PACKAGE_MTD_MLC_FLASH_OTP_LOCK
	bool "flash_otp_lock"

config BR2_PACKAGE_MTD_MLC_FLASH_OTP_WRITE
	bool "flash_otp_write"

config BR2_PACKAGE_MTD_MLC_FLASH_UNLOCK
	bool "flash_unlock"
	default y

config BR2_PACKAGE_MTD_MLC_FTL_CHECK
	bool "ftl_check"

config BR2_PACKAGE_MTD_MLC_FTL_FORMAT
	bool "ftl_format"

config BR2_PACKAGE_MTD_MLC_JFFS2DUMP
	bool "jffs2dump"

config BR2_PACKAGE_MTD_MLC_MKFSJFFS2
	bool "mkfs.jffs2"
	select BR2_PACKAGE_ZLIB
	select BR2_PACKAGE_LZO

config BR2_PACKAGE_MTD_MLC_MKFSUBIFS
	bool "mkfs.ubifs"
	select BR2_PACKAGE_ZLIB
	select BR2_PACKAGE_LZO
	select BR2_PACKAGE_UTIL_LINUX
	select BR2_PACKAGE_UTIL_LINUX_LIBUUID
	depends on BR2_USE_WCHAR # util-linux

comment "mkfs.ubifs needs a toolchain w/ wchar"
	depends on !BR2_USE_WCHAR

config BR2_PACKAGE_MTD_MLC_MTD_DEBUG
	bool "mtd_debug"
	default y

config BR2_PACKAGE_MTD_MLC_NANDDUMP
	bool "nanddump"
	default y

config BR2_PACKAGE_MTD_MLC_NANDTEST
	bool "nandtest"
	default y

config BR2_PACKAGE_MTD_MLC_NANDWRITE
	bool "nandwrite"
	default y

config BR2_PACKAGE_MTD_MLC_NFTLDUMP
	bool "nftldump"

config BR2_PACKAGE_MTD_MLC_NFTL_FORMAT
	bool "nftl_format"

config BR2_PACKAGE_MTD_MLC_RECV_IMAGE
	bool "recv_image"

config BR2_PACKAGE_MTD_MLC_RFDDUMP
	bool "rfddump"

config BR2_PACKAGE_MTD_MLC_RFDFORMAT
	bool "rfdformat"

config BR2_PACKAGE_MTD_MLC_SERVE_IMAGE
	bool "serve_image"

config BR2_PACKAGE_MTD_MLC_SUMTOOL
	bool "sumtool"

config BR2_PACKAGE_MTD_MLC_MTDINFO
	bool "mtdinfo"
	default y

config BR2_PACKAGE_MTD_MLC_UBIATTACH
	bool "ubiattach"
	default y

config BR2_PACKAGE_MTD_MLC_UBICRC32
	bool "ubicrc32"
	default y

config BR2_PACKAGE_MTD_MLC_UBIDETACH
	bool "ubidetach"
	default y

config BR2_PACKAGE_MTD_MLC_UBIFORMAT
	bool "ubiformat"
	default y

config BR2_PACKAGE_MTD_MLC_UBIMKVOL
	bool "ubimkvol"
	default y

config BR2_PACKAGE_MTD_MLC_UBINFO
	bool "ubinfo"
	default y

config BR2_PACKAGE_MTD_MLC_UBINIZE
	bool "ubinize"
	default y

config BR2_PACKAGE_MTD_MLC_UBIRENAME
	bool "ubirename"
	default y

config BR2_PACKAGE_MTD_MLC_UBIRMVOL
	bool "ubirmvol"
	default y

config BR2_PACKAGE_MTD_MLC_UBIRSVOL
	bool "ubirsvol"
	default y

config BR2_PACKAGE_MTD_MLC_UBIUPDATEVOL
	bool "ubiupdatevol"
	default y

config BR2_PACKAGE_MTD_MLC_UBIBLOCK
	bool "ubiblock"
	default y

config BR2_PACKAGE_MTD_MLC_UBIHEALTHD
	bool "ubihealthd"
	default y

endif
```

## mtd-mlc/Config.in.host
```kconfig
config BR2_PACKAGE_HOST_MTD_MLC
	bool "host mtd, jffs2 and ubi/ubifs tools"
	help
	  Build mtd, jffs2 and ubi/ubifs tools

	  http://www.linux-mtd.infradead.org/
```

## multifs/Config.in
```kconfig
config BR2_PACKAGE_MULTIFS
	bool "multifs"
	select BR2_PACKAGE_LIBFUSE
	help
      Fuse filesystem that presents a merged view of 1 or more directories.
      The "merged" directories can be changed on the fly.

	  https://github.com/Outernet-Project/multifs
```

## ondd/Config.in
```kconfig
menuconfig BR2_PACKAGE_ONDD
	bool "ondd"
	select BR2_PACKAGE_OPENSSL
	help
	  Outernet Data Delivery agent
	  
	  http://outernet.is/

if BR2_PACKAGE_ONDD

config BR2_ONDD_CACHEDIR
	string "Download cache directory"
	default "/mnt/cache"
	help
	  Temporary storage directory where ONDD will
	  store partial downloads.

config BR2_ONDD_CONFIGFILE
	string "Path to ondd config file"
	default "/etc/ondd.conf"
	help
	  ONDD stores and loads it's configuration from this file.

config BR2_ONDD_GROUP
	string "Group to use for the download directories"
	default "data"
	help
	  The download directories will be owned by this group.

choice BR2_ONDD_INSTALL_METHOD
	prompt "ONDD install method"
	default BR2_ONDD_INSTALL_LOCAL

config BR2_ONDD_INSTALL_LOCAL
	bool "do not install"
	help
	  ONDD binary will be installed separately, and only
	  its LICENSE file will be installed through this
	  package.

config BR2_ONDD_INSTALL_TARBALL
	bool "from hosted tarball"
	help
	  ONDD will be installed from a hosted tarball on
	  archive.outernet.is.

config BR2_ONDD_INSTALL_BUILD
	bool "from source"
	help
	  ONDD will be installed by building from local
	  source tree.

endchoice

if BR2_ONDD_INSTALL_BUILD

config BR2_ONDD_SRCDIR
	string "ONDD source directory"
	help
	  Path to ONDD sources.

config BR2_ONDD_LED_CONTROL
	bool "Enable ONDD LED control"
	help
	  If this option is disabled, the code that performs led control
	  will be excluded during compilation.

endif # BR2_ONDD_INSTALL_BUILD

endif # BR2_PACKAGE_ONDD
```

## pkgtool/Config.in
```kconfig
config BR2_PACKAGE_PKGTOOL
	bool "pkgtool"
	help
	  Firmware packaging and installation tool
	  
	  http://outernet.is/
```

## pkgtool/Config.in.host
```kconfig
config BR2_PACKAGE_HOST_PKGTOOL
	bool "host pkgtool"
	help
	  Firmware packaging and installation tool
	  
	  http://outernet.is/
```

## python-bitpack/Config.in
```kconfig
config BR2_PACKAGE_PYTHON_BITPACK
	bool "python-bitpack"
	depends on BR2_PACKAGE_PYTHON || BR2_PACKAGE_PYTHON3
	select BR2_PACKAGE_PYTHON_BITARRAY
	help
	  Data serialization library, essentially turning sequences of data
	  structures into a compact binary representation.

	  https://github.com/Outernet-Project/bitpack
```

## python-bottle-streamline/Config.in
```kconfig
config BR2_PACKAGE_PYTHON_BOTTLE_STREAMLINE
	bool "python-bottle-streamline"
	depends on BR2_PACKAGE_PYTHON_BOTTLE
	help
	  Bottle Streamline is a collection of classes for writing complex,
	  modular, and/or reusable route handlers using bottle web framework.

	  http://bottle-streamline.readthedocs.org/
```

## python-disentangler/Config.in
```kconfig
config BR2_PACKAGE_PYTHON_DISENTANGLER
	bool "python-disentangler"
	depends on BR2_PACKAGE_PYTHON || BR2_PACKAGE_PYTHON3
	help
	  Simple dependency tree builder, handles forward and reverse dependencies,
	  returning an ordered tree with its nodes ordered from root towards
	  leafs.

	  https://github.com/Outernet-Project/disentangler
```

## python-lftp/Config.in
```kconfig
menuconfig BR2_PACKAGE_PYTHON_LFTP
	bool "python-lftp"
	depends on (BR2_PACKAGE_PYTHON || BR2_PACKAGE_PYTHON3) && BR2_PACKAGE_PYTHON_LIBRARIAN
	select BR2_PACKAGE_PYTHON_PYFTPDLIB
	select BR2_PACKAGE_PYTHON_PYSENDFILE
	help
	  Librarian FTP server

	  https://github.com/Outernet-Project/lftp/

comment "python-lftp depends on python-librarian"
	depends on !BR2_PACKAGE_PYTHON_LIBRARIAN
```

## python-librarian-analytics/Config.in
```kconfig
config BR2_PACKAGE_PYTHON_LIBRARIAN_ANALYTICS
	bool "python-librarian-analytics"
	depends on (BR2_PACKAGE_PYTHON || BR2_PACKAGE_PYTHON3) && BR2_PACKAGE_PYTHON_LIBRARIAN
	select BR2_PACKAGE_PYTHON_USER_AGENTS
	select BR2_PACKAGE_PYTHON_BITPACK
	help
	  Librarian content usage analytics

	  https://github.com/Outernet-Project/librarian-analytics/

comment "python-librarian-analytics depends on python-librarian"
	depends on !BR2_PACKAGE_PYTHON_LIBRARIAN
```

## python-librarian-netinterfaces/Config.in
```kconfig
menuconfig BR2_PACKAGE_PYTHON_LIBRARIAN_NETINTERFACES
	bool "python-librarian-netinterfaces"
	depends on (BR2_PACKAGE_PYTHON || BR2_PACKAGE_PYTHON3) && BR2_PACKAGE_PYTHON_LIBRARIAN
	select BR2_PACKAGE_PYTHON_HWD
	select BR2_PACKAGE_PYTHON_PYHOSTAPDCONF
	help
	  List and manage network interfaces from librarian.

	  https://github.com/Othernet-Project/librarian-netinterfaces/


comment "python-librarian-netinterfaces depends on python-librarian"
	depends on !BR2_PACKAGE_PYTHON_LIBRARIAN
```

## python-librarian-remote/Config.in
```kconfig
config BR2_PACKAGE_PYTHON_LIBRARIAN_REMOTE
	bool "python-librarian-remote"
	depends on (BR2_PACKAGE_PYTHON || BR2_PACKAGE_PYTHON3) && BR2_PACKAGE_PYTHON_LIBRARIAN
	help
	  Remote SSH access setup tool

	  https://github.com/Othernet-Project/librarian-remote/

comment "python-librarian-remote depends on python-librarian"
	depends on !BR2_PACKAGE_PYTHON_LIBRARIAN
```

## python-librarian-sdr/Config.in
```kconfig
config BR2_PACKAGE_PYTHON_LIBRARIAN_SDR
	bool "python-librarian-sdr"
	depends on (BR2_PACKAGE_PYTHON || BR2_PACKAGE_PYTHON3) && BR2_PACKAGE_PYTHON_LIBRARIAN
	help
	  SDR demodulator installation for Librarian

	  https://github.com/Outernet-Project/librarian-sdr/

comment "python-librarian-sdr depends on python-librarian"
	depends on !BR2_PACKAGE_PYTHON_LIBRARIAN
```

## python-librarian-simplified/Config.in
```kconfig
config BR2_PACKAGE_PYTHON_LIBRARIAN_SIMPLIFIED
	bool "python-librarian-simplified"
	depends on (BR2_PACKAGE_PYTHON || BR2_PACKAGE_PYTHON3) && BR2_PACKAGE_PYTHON_LIBRARIAN
	help
	  Librarian simplified user interface with only a single view

	  https://github.com/Outernet-Project/librarian-simplified/

comment "python-librarian-simplified depends on python-librarian"
	depends on !BR2_PACKAGE_PYTHON_LIBRARIAN
```

## python-librarian-svm/Config.in
```kconfig
config BR2_PACKAGE_PYTHON_LIBRARIAN_SVM
	bool "python-librarian-svm"
	depends on (BR2_PACKAGE_PYTHON || BR2_PACKAGE_PYTHON3) && BR2_PACKAGE_PYTHON_LIBRARIAN
	help
	  Software version manager manages the rootfs overlays
	  on supported platforms (e.g., rxOS).

	  https://github.com/Othernet-Project/librarian-svm/

comment "python-librarian-svm depends on python-librarian"
	depends on !BR2_PACKAGE_PYTHON_LIBRARIAN
```

## python-librarian/Config.in
```kconfig
config BR2_PACKAGE_PYTHON_LIBRARIAN
	bool "python-librarian"
	depends on BR2_PACKAGE_PYTHON || BR2_PACKAGE_PYTHON3
	select BR2_PACKAGE_FFMPEG
	select BR2_PACKAGE_FFMPEG_GPL
	select BR2_PACKAGE_FFMPEG_FFMPEG
	select BR2_PACKAGE_FFMPEG_FFPROBE
	select BR2_PACKAGE_FFMPEG_SWSCALE
	select BR2_PACKAGE_PYTHON_BEAUTIFULSOUP4
	select BR2_PACKAGE_PYTHON_BOTTLE
	select BR2_PACKAGE_PYTHON_BOTTLE_FDSEND
	select BR2_PACKAGE_PYTHON_BOTTLE_UTILS
	select BR2_PACKAGE_PYTHON_BOTTLE_STREAMLINE
	select BR2_PACKAGE_PYTHON_CHAINABLE_VALIDATORS
	select BR2_PACKAGE_PYTHON_CSSMIN
	select BR2_PACKAGE_PYTHON_CONFLOADER
	select BR2_PACKAGE_PYTHON_DATEUTIL
	select BR2_PACKAGE_PYTHON_DISENTANGLER
	select BR2_PACKAGE_PYTHON_FSAL
	select BR2_PACKAGE_PYTHON_GEVENT
	select BR2_PACKAGE_PYTHON_GREENTASKS
	select BR2_PACKAGE_PYTHON_HWD
	select BR2_PACKAGE_PYTHON_MAKO
	select BR2_PACKAGE_PYTHON_MARKUPSAFE
	select BR2_PACKAGE_PYTHON_ONDD_IPC
	select BR2_PACKAGE_PYTHON_PBKDF2
	select BR2_PACKAGE_PYTHON_PYHOSTAPDCONF
	select BR2_PACKAGE_PYTHON_PYTZ
	select BR2_PACKAGE_PYTHON_SQUERY_PG
	select BR2_PACKAGE_PYTHON_SQLIZE_PG
	select BR2_PACKAGE_PYTHON_WEBASSETS
	help
	  Content library manager for Othernet Receiver

	  https://github.com/Othernet-Project/librarian/
```
