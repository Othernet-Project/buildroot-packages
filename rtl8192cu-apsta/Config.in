## rtl8192cu-apsta/Config.in
```kconfig
config BR2_PACKAGE_RTL8192CU_APSTA
	bool "RTL8192CU AP+STA driver"
	depends on BR2_LINUX_KERNEL
	help
	  Linux kernel module for the rtl8192cu/rtl8188cu AP+STA module

	  https://github.com/Othernet-Project/rtl8192cu-fixes
```

## rtl8723au_bt/Config.in
```kconfig
config BR2_PACKAGE_RTL8723AU_BT
	bool "rtl8723au_bt"
	depends on BR2_LINUX_KERNEL
	help
	  Linux kernel module for the rtl8723bu USB WiFi module - BLUEtooth support

	  https://github.com/Othernet-Project/rtl8723au_bt
```

## rtl8723bs/Config.in
```kconfig
config BR2_PACKAGE_RTL8723BS
	bool "rtl8723bs"
	depends on BR2_LINUX_KERNEL
	help
	  Linux kernel module for the rtl8723bs SDIO WiFi module.

	  https://github.com/hadess/rtl8723bs
```

## rtl8723bu/Config.in
```kconfig
config BR2_PACKAGE_RTL8723BU
	bool "rtl8723bu"
	depends on BR2_LINUX_KERNEL
	help
	  Linux kernel module for the rtl8723bu USB WiFi module.

	  https://github.com/lwfinger/rtl8723bu
```

## rtl8723ds-ntc/Config.in
```kconfig
config BR2_PACKAGE_RTL8723DS_NTC
	bool "rtl8723ds ntc version"
	depends on BR2_LINUX_KERNEL
	help
	  Linux kernel module for the rtl8723ds SDIO WiFi module.

	  https://github.com/NextThingCo/RTL8723DS
```

## telemetry/Config.in
```kconfig
menuconfig BR2_PACKAGE_TELEMETRY
	bool "telemetry"
	depends on BR2_PACKAGE_PYTHON
	help
	  Client-side script for sending Outernet signal monitoring data to a
	  central server.
	  
	  https://github.com/Outernet-Project/telemetry_client
```

## wptdm/Config.in
```kconfig
config BR2_PACKAGE_WPTDM
	bool "wptdm"
	select BR2_PACKAGE_OPENSSL
	select BR2_PACKAGE_LIBCURL
	help
	  Remote management client
	  
	  http://outernet.is/
```
